## config/boards/shields/jj40/Kconfig.defconfig
```kconfig
# Copyright (c) 2020 The ZMK Contributors
# SPDX-License-Identifier: MIT

if SHIELD_jj40

config ZMK_KEYBOARD_NAME
	default "JJ40"

endif
```

## config/boards/shields/jj40/Kconfig.shield
```kconfig
# Copyright (c) 2020 The ZMK Contributors
# SPDX-License-Identifier: MIT

config SHIELD_jj40
	def_bool $(shields_list_contains,jj40)
```
